#include "CaptureSensor.h"

// ---------------------------------------------------------------------------
// ИНИЦИАЛИЗАЦИЯ ЖЕЛЕЗА
// ---------------------------------------------------------------------------
//
// Перенесено из captureBegin() в stm/phone_link/phone_link.ino дословно.
//
// PA15 это TIM2_CH1 (проверено по PeripheralPins ядра 2.10.1), а SENSOR_PIN
// PB8 — TIM4_CH3. Режим PWM input работает только от TI1/TI2, поэтому
// аппаратный захват возможен именно на PA15 и невозможен на PB8. Энкодер
// запаян на оба пина: один выход на два высокоомных входа.
#if !defined(CAPSENS_HOST)
void CaptureSensor::init() {
  __HAL_RCC_GPIOA_CLK_ENABLE();
  __HAL_RCC_TIM2_CLK_ENABLE();
  // PA15 после сброса отдан под JTDI. Отладке по SWD (PA13/PA14) это не
  // мешает, но пин надо явно перевести в AF1 = TIM2_CH1.
  GPIO_InitTypeDef g = {0};
  // ПОДТЯЖКА ВВЕРХ, а не NOPULL: после сброса на PA15 подтяжка есть, а провод
  // общий с PB8 — сняв её, мы изменили бы условия на узле для ОБОИХ трактов и
  // сравнивали бы уже не способы чтения, а разные электрические режимы.
  g.Pin = GPIO_PIN_15; g.Mode = GPIO_MODE_AF_PP; g.Pull = GPIO_PULLUP;
  g.Speed = GPIO_SPEED_FREQ_HIGH; g.Alternate = GPIO_AF1_TIM2;
  HAL_GPIO_Init(GPIOA, &g);
  configureTimer();
  // Базовый Sensor::init() несколько раз дёргает getSensorAngle(), чтобы
  // первые getAngle()/getVelocity() не выдали скачок из нуля. Здесь он ещё и
  // прогревает признак годности: good_reads_to_recover набирается сразу.
  this->Sensor::init();
}
#else
void CaptureSensor::init() {
  // На хосте пинов и тактирования нет — настраиваются только регистры.
  configureTimer();
  this->Sensor::init();
}
#endif

void CaptureSensor::configureTimer() {
  // Каналы и подчинённый режим ГАСЯТСЯ ПЕРЕД настройкой: поля CC1S/CC2S
  // записываемы только при выключенном канале (CCxE = 0).
  tim_->CR1 = 0; tim_->CCER = 0; tim_->SMCR = 0;
  tim_->PSC = 0; tim_->ARR = 0xFFFFFFFF;
  // CCMR1: CC1S=01 (CCR1 <- TI1), CC2S=10 (CCR2 <- TI1), фильтры по 2.
  tim_->CCMR1 = (1u << 0) | (2u << 4) | (2u << 8) | (2u << 12);
  // CC2P: второй канал ловит СПАД, первый — нарастающий фронт.
  tim_->CCER  = TIM_CCER_CC1E | TIM_CCER_CC2E | TIM_CCER_CC2P;
  // SMCR: TS=101 (TI1FP1), SMS=100 (reset) — CNT обнуляется каждым
  // нарастающим фронтом, поэтому CNT это ВОЗРАСТ ТЕКУЩЕГО КАДРА.
  tim_->SMCR  = (5u << TIM_SMCR_TS_Pos) | (4u << TIM_SMCR_SMS_Pos);
  tim_->CR1  |= TIM_CR1_CEN;
}

// ---------------------------------------------------------------------------
// ЧТЕНИЕ ЗАХВАТА
// ---------------------------------------------------------------------------
bool CaptureSensor::readRaw(CaptureStatus &st) {
  // ПОРЯДОК ЧТЕНИЯ СТРОГИЙ: сначала СНИМОК SR, потом CCR2 (его чтение
  // сбрасывает CC2IF), потом CCR1, и ТОЛЬКО ПОТОМ CNT.
  //
  // Возраст читается ПОСЛЕДНИМ намеренно. Между чтением CCR2 и чтением CNT
  // может успеть прийти спад: тогда CCR2 у нас уже старый (согласованный), а
  // возраст — уже новый (больше ширины), и проверка ниже назовёт пару
  // несогласованной. Это ЛОЖНЫЙ ОТКАЗ, то есть ошибка в безопасную сторону.
  // При обратном порядке та же гонка дала бы ложное ПРИНЯТИЕ смеси кадров.
  uint32_t sr = tim_->SR;
  uint32_t h  = tim_->CCR2;
  uint32_t p  = tim_->CCR1;
  uint32_t age = tim_->CNT;

  // CC1OF — единственный аппаратный признак ПРОПУЩЕННОГО кадра. Чтением CCR1
  // он НЕ снимается, поэтому сбрасывается явно: иначе залипнет навсегда и
  // перестанет что-либо значить.
  st.lost = (sr & TIM_SR_CC1OF) != 0;
  tim_->SR = ~TIM_SR_CC1OF;

  st.period = p; st.high = h;
  st.cc2if = (sr & TIM_SR_CC2IF) != 0;

  // -- ЖИВ ЛИ САМ ТАЙМЕР ---------------------------------------------------
  //
  // Единственное, что различает «замерли регистры» и «вал стоит, тракт жив», —
  // движение СЧЁТЧИКА. Ширина у неподвижного вала постоянна законно, период
  // постоянен всегда; непрерывно меняется только CNT. Поэтому запоминаем
  // последнее значение счётчика и момент, когда оно менялось.
  const unsigned long now_us = micros();
#ifdef CAPSENS_MUT_NO_FROZEN_CHECK
  st.alive = true;                       // МУТАЦИЯ: замирание таймера не ловится
  (void)now_us;
#else
  if (!have_cnt_ || age != last_cnt_) {
    last_cnt_ = age;
    have_cnt_ = true;
    cnt_change_us_ = now_us;
  }
  // Вычитание беззнаковых — переполнение micros() (каждые 71 минуту) проходит
  // без особого случая.
  st.alive = (unsigned long)(now_us - cnt_change_us_) < CAPSENS_FROZEN_US;
#endif

  // -- ДВА РЕЖИМА ЗАЩЁЛКИВАНИЯ, И ОБА ГОДНЫ ------------------------------
  //
  // ЧТО ЗАЩЁЛКНУТО. Пусть нарастающие фронты R0, R1, R2..., кадр k это
  // [Rk, Rk+1), спад кадра k наступает при CNT == ширина(k). CCR1 захватывает
  // по нарастающему фронту, CCR2 по спаду, CNT обнуляется нарастающим.
  // Значит внутри кадра k+1:
  //     CNT < ширина(k+1): CCR1 = период(k), CCR2 = ширина(k)
  //                        -> оба из кадра k, но отсчёт СТАРШЕ НА КАДР
  //     CNT > ширина(k+1): CCR1 = период(k), CCR2 = ширина(k+1)
  //                        -> ширина СВЕЖАЯ, период с прошлого кадра
  //
  // ПОЧЕМУ ВТОРОЙ СЛУЧАЙ НЕ БРАК, ХОТЯ ВЫГЛЯДИТ СМЕСЬЮ. Период кадра датчика
  // стабилен: измеренный дрейф 0.02% (сигма около 30 тиков из 156700). Взять
  // период соседнего кадра — ошибка скважности в четвёртом знаке, то есть
  // сотые доли градуса. А отсчёт при этом СВЕЖИЙ.
  //
  // ЧЕМ БЫЛА ПЛОХА ПРЕЖНЯЯ РЕДАКЦИЯ (st.paired = age <= h). Она браковала
  // именно свежий случай и принимала устаревший — для контура управления
  // выбор ровно наоборот. Хуже того, доля брака равна (1 - скважность), то
  // есть ЗАВИСИТ ОТ УГЛА: на нижней части оборота тракт слеп почти всегда.
  //
  // ЭТО НЕ РАССУЖДЕНИЕ, А ВОСПРОИЗВЕДЁННЫЙ НА ЖЕЛЕЗЕ ОТКАЗ. 22.08 скетч
  // looprate_g431 отказал на исправном тракте: скважность 0.156 (вал стоял на
  // 57 градусах), paired=0, четыре негодных чтения подряд, при том что сам
  // угол класс считал верно — 0.9706 против 0.9661 рад у боевого тракта.
  //
  // ПРОШИВКА (stm/phone_link) принимает ОБА случая и различает их флагом,
  // поправляя возраст. Живая ветка — она, и она права. Здесь то же правило.
  st.prev_frame = (age <= h);
  // Возраст ИМЕННО ЭТОГО отсчёта: в устаревшем случае к нему добавляется
  // целый кадр, иначе потребитель решит, что отсчёт свежее, чем он есть.
#ifdef CAPSENS_MUT_NO_AGE_FIX
  st.age = age;                          // МУТАЦИЯ: поправка возраста снята
#else
  st.age = st.prev_frame ? (age + p) : age;
#endif
  // Пара непригодна только если разобрать её нельзя вовсе — это ловят
  // проверки периода и ширины ниже. Отдельного условия на согласованность НЕ
  // ОСТАЛОСЬ, и придумывать его, чтобы «проверка была», нельзя: прежнее
  // условие как раз и было такой придуманной проверкой, и стоило слепоты на
  // трети оборота.
  st.paired = true;

  // Границы периода — те же, что стояли в captureRead().
#ifdef CAPSENS_MUT_NO_PERIOD_CHECK
  st.period_ok = true;                   // МУТАЦИЯ: границы периода сняты
#else
  st.period_ok = (p > CAPSENS_PERIOD_MIN_TICKS) && (p < CAPSENS_PERIOD_MAX_TICKS);
#endif

  st.width_ok = (h > 0) && (h < p);

  // ФРОНТОВ НЕТ. Возраст больше двух максимальных периодов означает, что
  // нарастающего фронта не было дольше двух кадров: сигнал пропал. Формально
  // такое чтение уже отсеяно проверкой пары (возраст заведомо больше ширины),
  // но РАЗЛИЧАТЬ эти два случая обязательно: «попал в мёртвый участок кадра»
  // проходит сотни раз в секунду и безобиден, а «фронтов нет» — это обрыв, и
  // путать их в разборе полётов нельзя.
#ifdef CAPSENS_MUT_NO_EDGE_CHECK
  st.edges = true;                       // МУТАЦИЯ: обрыв не распознаётся
#else
  // По СЫРОМУ возрасту: поправка на кадр здесь только мешала бы.
  st.edges = (age <= CAPSENS_AGE_MAX_TICKS);
#endif

  st.ok = st.paired && st.period_ok && st.width_ok && st.edges && st.alive;
  last_ = st;
  return st.ok;
}

// ---------------------------------------------------------------------------
// УГОЛ
// ---------------------------------------------------------------------------
float CaptureSensor::getSensorAngle() {
  CaptureStatus st;
  // ОДИН ПРОХОД, БЕЗ ОЖИДАНИЯ. Здесь нельзя ни while, ни повторного чтения
  // «а вдруг теперь сойдётся»: эта функция стоит внутри loopFOC().
  const unsigned long now_us = micros();
  if (!readRaw(st)) {
    good_streak_ = 0;
    good_since_us_ = now_us;
    if (bad_streak_ < 255) bad_streak_++;
    // ПОРОГ ВО ВРЕМЕНИ, А НЕ В ЧТЕНИЯХ. В чтениях он был функцией частоты
    // цикла: при 33 кГц восемь чтений это четверть миллисекунды, а
    // задумывалось несколько кадров датчика по 922 мкс.
#ifdef CAPSENS_MUT_HEALTH_BY_READS
    if (bad_streak_ >= 8) healthy_ = false;          // МУТАЦИЯ: порог в чтениях
#else
    if (bad_since_us_ == 0) bad_since_us_ = now_us;
    if ((unsigned long)(now_us - bad_since_us_) >= bad_us_to_fail) healthy_ = false;
#endif
    return angle_;   // удержание последнего годного, см. объяснение в .h
  }
  bad_since_us_ = 0;

  const float duty = (float)st.high / (float)st.period;
  // Скважность -> радианы. Смещение CAPSENS_DUTY_MIN задаёт только положение
  // нуля; масштаб задаёт измеренный наклон.
  float a = (duty - CAPSENS_DUTY_MIN) * CAPSENS_DEG_PER_DUTY
            * (3.14159265358979f / 180.0f);
  // Свёртка в [0, 2*PI). Циклом, а не fmodf: аргумент здесь всегда в пределах
  // одного оборота от диапазона, так что это один-два вычитания, и оно
  // дешевле деления. Границы шва сходятся ТОЧНО, потому что размах выведен из
  // наклона, а не измерен отдельно (см. CAPSENS_DUTY_SPAN).
  const float two_pi = 6.28318530717959f;
  while (a < 0.0f) a += two_pi;
  while (a >= two_pi) a -= two_pi;

  angle_ = a;
  has_angle_ = true;
  bad_streak_ = 0;
  if (good_streak_ < 255) good_streak_++;
#ifdef CAPSENS_MUT_HEALTH_BY_READS
  if (good_streak_ >= 3) healthy_ = true;            // МУТАЦИЯ: порог в чтениях
#else
  if (good_since_us_ == 0) good_since_us_ = now_us;
  if ((unsigned long)(now_us - good_since_us_) >= good_us_to_recover) healthy_ = true;
#endif
  return angle_;
}

// ---------------------------------------------------------------------------
// МЕТКА ВРЕМЕНИ УГЛА — ПО ФРОНТУ, А НЕ ПО МОМЕНТУ ОПРОСА
// ---------------------------------------------------------------------------
//
// ПОЧЕМУ ЭТО НЕ ОДНА СТРОКА ВНУТРИ getSensorAngle(), как предполагалось в
// плане. Базовый Sensor::update() устроен так:
//
//     float val = getSensorAngle();
//     if (val < 0) return;
//     angle_prev_ts = _micros();      <-- ЗАТИРАЕТ всё, что мы записали сами
//
// То есть правка внутри getSensorAngle() была бы молча отменена, и метка
// осталась бы привязанной к опросу. Поэтому поправка вносится ПОСЛЕ вызова
// базового update().
//
// ЧТО ЭТО ЧИНИТ. Отсчёт защёлкнут железом в момент фронта, а опрашивается
// программой когда придётся: транспортная задержка гуляет от 0 до полутора
// кадров И ЗАВИСИТ ОТ САМОГО УГЛА (ширина импульса — это и есть угол). Значит
// в измеряемую плавность вносится помеха ровно раз на оборот — то самое, что
// контур должен подавлять. На её фоне такт цикла 30 мкс не значит ничего.
//
// Возраст переводится из тиков TIM2 в микросекунды делением на 170.
// ГЕЙТ ПО ГОДНОСТИ ОБЯЗАТЕЛЕН, и стоил он ошибки в первой редакции.
//
// Возраст берётся из последнего чтения — но у ЗАБРАКОВАННОГО чтения он
// произвольный: на севшем датчике CNT уходит от CCR1 на секунды. Поправка без
// гейта уводила метку назад на 17.6 и 20.0 с (воспроизведено), после чего
// Sensor::getVelocity() попадал в ветку «переполнение micros()», и первое
// чтение после восстановления давало 0.000038 рад/с вместо 0.20 — занижение
// в 5300 раз прямо на входе ПИ-регулятора. То есть сторож живости без этой
// строки вреднее своего отсутствия.
void CaptureSensor::update() {
  Sensor::update();
#ifndef CAPSENS_MUT_TS_AT_POLL
  if (last_.ok) angle_prev_ts -= (long)(last_.age / CAPSENS_TICKS_PER_US);
#endif
}

bool CaptureSensor::isHealthy() const {
#ifdef CAPSENS_MUT_HEALTH_ALWAYS_OK
  return true;                           // МУТАЦИЯ: признак годности бесполезен
#else
  return healthy_ && has_angle_;
#endif
}
