/*
 * Тесты закона управления и мутации §9 спецификации.
 *
 * Гоняется на ноутбуке обычным g++: control_v2.h не зависит ни от Arduino, ни
 * от SimpleFOC, ни от системного времени — время подаётся аргументом. Это тот
 * же код, который поедет на плату.
 *
 * Смысл мутационных тестов. Прохождение тестов само по себе не говорит
 * НИЧЕГО: тест, не имеющий различающей силы, проходит и на исправном коде, и
 * на сломанном. §9 задаёт четыре поломки и требует, чтобы каждая роняла
 * названный тест. Проверяется именно это соответствие — не «тесты зелёные»,
 * а «тесты умеют краснеть, и краснеет нужный».
 *
 *   tools/link/control_tests.sh
 */
#include <cstdio>
#include <cstring>
#include <cmath>
#include "control_v2.h"

static int failed = 0;
static const char *cur = "";

static void ok(bool cond, const char *what) {
  if (!cond) { failed++; printf("  СБОЙ  %s: %s\n", cur, what); }
}

// ---------------------------------------------------------------- пачка
//
// Сценарий: связь замерла, кадры накопились в буфере транспорта и пришли
// пачкой, ПОСЛЕДНИМ придя устаревший. Применён должен быть самый свежий, а не
// последний пришедший. Без свежести приёмник выполнит устаревшую уставку —
// то есть поедет по вчерашней команде.
static void test_burst() {
  cur = "пачка";
  ctl::Ctl c; c.init(ctl::defaults());
  uint32_t t = 1000;
  c.accept(10, 0.0f, 0.0f, t);

  // Пачка: seq 11, 12, 13 — и следом устаревший 12 с большой уставкой.
  c.accept(11, 0.1f, 0.0f, t);
  c.accept(12, 0.2f, 0.0f, t);
  c.accept(13, 0.3f, 0.0f, t);
  bool applied = c.accept(12, 1.9f, 0.0f, t);   // устаревший

  ok(!applied, "устаревший кадр пачки НЕ должен применяться");
  ok(fabsf(c.w_pkt - 0.3f) < 1e-6f, "уставка должна остаться от самого свежего кадра");
}

// ------------------------------------------------- обрыв с ненулевым w_dot
//
// Сценарий: телефон замолчал, а последняя уставка содержала ускорение.
// Экстраполяция обязана упереться в потолок 150 мс и не разгонять вал дальше.
// Без потолка уставка растёт до самого срабатывания сторожа, то есть вдвое
// дольше, и вал успевает уехать.
static void test_break_with_wdot() {
  cur = "обрыв с w_dot";
  ctl::Ctl c; c.init(ctl::defaults());
  uint32_t t = 1000;

  // Ускорение 0.5 рад/с^2, а НЕ 4. При 4 связывающим ограничением становится
  // рампа (1 рад/с^2), она держит команду одинаково и с потолком, и без него,
  // и разница на выходе не видна вовсе. Первая редакция теста именно поэтому
  // и не ловила мутацию. При 0.5 уставка растёт медленнее рампы, команда
  // следует за уставкой, и потолок становится наблюдаемым.
  c.accept(1, 0.0f, 0.5f, t);

  // 290 мс без новых кадров: сторож (300 мс) ещё не сработал.
  for (uint32_t d = 0; d <= 290; d += 10) c.step(t + d, 0.01f, 0.0f);

  ok(c.st_extrap_cap, "бит потолка обязан стоять на 290 мс");

  // ЕДИНСТВЕННАЯ содержательная проверка — фактическая команда, а не
  // пересчитанная тестом уставка. Первая редакция считала goal сама, да ещё и
  // через st_extrap_cap, которого мутация не касается: выражение сравнивалось
  // само с собой и проходило всегда.
  //
  // С потолком: 0.5 * 0.150 = 0.075 рад/с.
  // Без потолка: 0.5 * 0.290 = 0.145 рад/с — рампа успевает и туда.
  ok(c.w_ramp < 0.10f, "команда не должна расти после потолка экстраполяции");
}

// ------------------------------------------------------- скачок уставки
//
// Сценарий: телефон прислал уставку, отличающуюся от текущей на всю шкалу.
// Вал обязан ехать наклоном не круче MAX_ACCEL. Без рампы команда прыгнет
// мгновенно — а это и есть рывок, ради недопущения которого рампа стоит.
static void test_setpoint_jump() {
  cur = "скачок уставки";
  ctl::Ctl c; c.init(ctl::defaults());
  ctl::Params p = ctl::defaults();
  uint32_t t = 1000;
  c.accept(1, 0.0f, 0.0f, t);
  c.step(t, 0.01f, 0.0f);

  c.accept(2, 2.0f, 0.0f, t);      // скачок 0 -> 2.0 рад/с

  float prev = c.w_ramp;
  float worst = 0.0f;
  for (uint32_t d = 0; d <= 100; d += 10) {
    c.step(t + d, 0.01f, 0.0f);
    float jump = fabsf(c.w_ramp - prev);
    if (jump > worst) worst = jump;
    prev = c.w_ramp;
  }
  float allowed = p.max_accel * 0.01f;
  ok(worst <= allowed + 1e-6f, "приращение команды за шаг не должно превышать MAX_ACCEL*dt");
  ok(c.w_ramp < 2.0f, "за 100 мс команда не может дойти до 2.0 рад/с при рампе 1 рад/с^2");
}

// ------------------------------ ложный срыв после возобновления связи
//
// Сценарий: связь пропала, сторож остановил вал. За время молчания вал
// провернули рукой — угол ушёл, а интеграл команды нет. Связь вернулась.
// Детектор срыва обязан начать счёт заново, иначе поднимет бит на ровном
// месте: расхождение накопилось, пока управления не было вовсе.
static void test_false_slip_after_watchdog() {
  cur = "ложный срыв после watchdog";
  ctl::Ctl c; c.init(ctl::defaults());
  uint32_t t = 1000;
  c.accept(1, 0.0f, 0.0f, t);

  // 1.2 с молчания: сторож сработал. Угол за это время уехал на 0.5 рад —
  // вал провернули рукой.
  float theta = 0.0f;
  for (uint32_t d = 0; d <= 1200; d += 10) {
    if (d > 300) theta += 0.5f / 90.0f;     // плавный увод рукой
    c.step(t + d, 0.01f, theta);
  }
  ok(c.st_watchdog, "сторож обязан был сработать");

  // Связь вернулась, команда ноль, вал стоит там, куда его увели.
  uint32_t t2 = t + 1210;
  c.accept(2, 0.0f, 0.0f, t2);
  bool slip_seen = false;
  for (uint32_t d = 0; d <= 1500; d += 10) {
    c.step(t2 + d, 0.01f, theta);
    if (c.st_slip) slip_seen = true;
  }
  ok(!slip_seen, "срыв НЕ должен подниматься после возобновления связи");
}

// ------------------------------------------- контроль: срыв обязан ловиться
//
// Без этого теста предыдущий проходил бы и на детекторе, выключенном
// навсегда. Проверяем, что настоящий срыв всё-таки виден.
static void test_real_slip_detected() {
  cur = "настоящий срыв ловится";
  ctl::Ctl c; c.init(ctl::defaults());
  uint32_t t = 1000;
  float theta = 0.0f;
  bool slip_seen = false;
  for (uint32_t d = 0; d <= 3000; d += 10) {
    c.accept((uint8_t)((d / 100 + 1) & 0x7F), 0.5f, 0.0f, t + d);
    c.step(t + d, 0.01f, theta);
    // Вал НЕ едет: держим угол на месте, команда идёт.
    if (c.st_slip) slip_seen = true;
  }
  ok(slip_seen, "удержанный вал при идущей команде обязан дать бит срыва");
}

int main() {
  printf("=== тесты закона управления ===\n");
#if defined(MUT_NO_FRESHNESS)
  printf("МУТАЦИЯ: свежесть выключена\n");
#elif defined(MUT_NO_EXTRAP_CAP)
  printf("МУТАЦИЯ: потолок экстраполяции снят\n");
#elif defined(MUT_NO_RAMP)
  printf("МУТАЦИЯ: рампа обойдена\n");
#elif defined(MUT_NO_SLIP_RESET)
  printf("МУТАЦИЯ: интеграл срыва не сбрасывается\n");
#else
  printf("сборка БЕЗ мутаций\n");
#endif

  test_burst();
  test_break_with_wdot();
  test_setpoint_jump();
  test_false_slip_after_watchdog();
  test_real_slip_detected();

  if (failed == 0) printf("ИТОГ: все тесты прошли\n");
  else             printf("ИТОГ: провалов %d\n", failed);
  return failed == 0 ? 0 : 1;
}
